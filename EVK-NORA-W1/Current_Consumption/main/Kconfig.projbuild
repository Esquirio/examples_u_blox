## EVK-NORA-W1/Current_Consumption/main/Kconfig.projbuild
```kconfig
menu "Application Configuration"

    menu "Wi-Fi Settings"
        config ESP_WIFI_SSID
            string "WiFi SSID"
            default "myssid"
            help
                SSID (network name) for the application to connect to.

        config ESP_WIFI_PASSWORD
            string "WiFi Password"
            default "mypassword"
            help
                WiFi password (WPA or WPA2) for the example to use.

        config ESP_WIFI_CHANNEL
            int "WiFi channel"
            default 1
            range 1 11
            help
                WiFi change 1-11.

        config ESP_WIFI_LISTEN_INTERVAL
            int "WiFi listen interval"
            default 3
            help
                Interval for station to listen to beacon from AP. The unit of listen interval is one beacon interval.
                For example, if beacon interval is 100 ms and listen interval is 3, the interval for station to listen
                to beacon is 300 ms.

        config ESP_WIFI_BEACON_TIMEOUT
            int "WiFi beacon timeout"
            default 6
            range 6 30
            help
                For Station, If the station does not receive a beacon frame from the connected SoftAP during the
                inactive time, disconnect from SoftAP. Default 6s.
        
        config ESP_MAXIMUM_RETRY
            int "Maximum retry"
            default 5
            help
                Set the Maximum retry to avoid station reconnecting to the AP unlimited when the AP is really inexistent.

        config ESP_WIFI_PW_ID
            string "PASSWORD IDENTIFIER"
            depends on  ESP_WPA3_SAE_PWE_HASH_TO_ELEMENT|| ESP_WPA3_SAE_PWE_BOTH
            default ""
            help
                password identifier for SAE H2E
        
        choice ESP_WIFI_SAE_MODE
            prompt "WPA3 SAE mode selection"
            default ESP_WPA3_SAE_PWE_BOTH
            help
                Select mode for SAE as Hunt and Peck, H2E or both.
            config ESP_WPA3_SAE_PWE_HUNT_AND_PECK
                bool "HUNT AND PECK"
            config ESP_WPA3_SAE_PWE_HASH_TO_ELEMENT
                bool "H2E"
            config ESP_WPA3_SAE_PWE_BOTH
                bool "BOTH"
        endchoice

        choice ESP_WIFI_SCAN_AUTH_MODE_THRESHOLD
            prompt "WiFi Scan auth mode threshold"
            default ESP_WIFI_AUTH_WPA2_PSK
            help
                The weakest authmode to accept in the scan mode.
                This value defaults to ESP_WIFI_AUTH_WPA2_PSK incase password is present and ESP_WIFI_AUTH_OPEN is used.
                Please select ESP_WIFI_AUTH_WEP/ESP_WIFI_AUTH_WPA_PSK incase AP is operating in WEP/WPA mode.

            config ESP_WIFI_AUTH_OPEN
                bool "OPEN"
            config ESP_WIFI_AUTH_WEP
                bool "WEP"
            config ESP_WIFI_AUTH_WPA_PSK
                bool "WPA PSK"
            config ESP_WIFI_AUTH_WPA2_PSK
                bool "WPA2 PSK"
            config ESP_WIFI_AUTH_WPA_WPA2_PSK
                bool "WPA/WPA2 PSK"
            config ESP_WIFI_AUTH_WPA3_PSK
                bool "WPA3 PSK"
            config ESP_WIFI_AUTH_WPA2_WPA3_PSK
                bool "WPA2/WPA3 PSK"
            config ESP_WIFI_AUTH_WAPI_PSK
                bool "WAPI PSK"
        endchoice
    endmenu

    menu "TCP connection Settings"
        choice EXAMPLE_IP_MODE
            prompt "IP Version"
            depends on EXAMPLE_SOCKET_IP_INPUT_STRING
            help
                Example can use either IPV4 or IPV6.
    
            config EXAMPLE_IPV4
                bool "IPV4"
    
            config EXAMPLE_IPV6
                bool "IPV6"
    
        endchoice
    
        config EXAMPLE_IPV4_ADDR
            string "IPV4 Address"
            default "192.168.0.32"
            depends on EXAMPLE_IPV4
            help
                The example will connect to this IPV4 address.
    
        config EXAMPLE_IPV6_ADDR
            string "IPV6 Address"
            default "FE80::30AD:E57B:C212:68AD"
            depends on EXAMPLE_IPV6
            help
                The example will connect to this IPV6 address.
    
        config EXAMPLE_PORT
            int "Port"
            range 0 65535
            default 44440
            help
                The remote port to which the client example will connect to.
    
        choice EXAMPLE_INTERFACE
            prompt "Interface selection"
            depends on EXAMPLE_IPV6
            help
                Example can use either "Auto" or "User specified".
    
            config EXAMPLE_IFACE_AUTO
                bool "Auto"
    
            config EXAMPLE_USER_SPECIFIED_IFACE
                bool "User specified interface"
        endchoice
    
        config EXAMPLE_USER_SPECIFIED_IFACE_NAME
            string "User specified interface name"
            default "st1"
            depends on EXAMPLE_USER_SPECIFIED_IFACE
            help
                This interface will be used for communication.
    
        choice EXAMPLE_SOCKET_IP_INPUT
            prompt "Socket example source"
            default EXAMPLE_SOCKET_IP_INPUT_STRING
            help
                Selects the input source of the IP used in the example.
    
            config EXAMPLE_SOCKET_IP_INPUT_STRING
                bool "From string"
    
            config EXAMPLE_SOCKET_IP_INPUT_STDIN
                bool "From stdin"
        endchoice
    endmenu
    
endmenu
```

## EVK-NORA-W1/Light_sleep_vs_Power_Save/light_sleep_mode/main/Kconfig.projbuild
```kconfig
menu "Example Configuration"

    config ESP_WIFI_SSID
        string "WiFi SSID"
        default "myssid"
        help
            SSID (network name) for the example to connect to.

    config ESP_WIFI_PASSWORD
        string "WiFi Password"
        default "mypassword"
        help
            WiFi password (WPA or WPA2) for the example to use.

    config ESP_MAXIMUM_RETRY
        int "Maximum retry"
        default 5
        help
            Set the Maximum retry to avoid station reconnecting to the AP unlimited when the AP is really inexistent.

    config ESP_WIFI_PW_ID
        string "PASSWORD IDENTIFIER"
        depends on  ESP_WPA3_SAE_PWE_HASH_TO_ELEMENT|| ESP_WPA3_SAE_PWE_BOTH
        default ""
        help
            password identifier for SAE H2E

    config ESP_MAXIMUM_RETRY
        int "Maximum retry"
        default 5
        help
            Set the Maximum retry to avoid station reconnecting to the AP unlimited when the AP is really inexistent.

    choice ESP_WIFI_SCAN_AUTH_MODE_THRESHOLD
        prompt "WiFi Scan auth mode threshold"
        default ESP_WIFI_AUTH_WPA2_PSK
        help
            The weakest authmode to accept in the scan mode.
            This value defaults to ESP_WIFI_AUTH_WPA2_PSK incase password is present and ESP_WIFI_AUTH_OPEN is used.
            Please select ESP_WIFI_AUTH_WEP/ESP_WIFI_AUTH_WPA_PSK incase AP is operating in WEP/WPA mode.

        config ESP_WIFI_AUTH_OPEN
            bool "OPEN"
        config ESP_WIFI_AUTH_WEP
            bool "WEP"
        config ESP_WIFI_AUTH_WPA_PSK
            bool "WPA PSK"
        config ESP_WIFI_AUTH_WPA2_PSK
            bool "WPA2 PSK"
        config ESP_WIFI_AUTH_WPA_WPA2_PSK
            bool "WPA/WPA2 PSK"
        config ESP_WIFI_AUTH_WPA3_PSK
            bool "WPA3 PSK"
        config ESP_WIFI_AUTH_WPA2_WPA3_PSK
            bool "WPA2/WPA3 PSK"
        config ESP_WIFI_AUTH_WAPI_PSK
            bool "WAPI PSK"
    endchoice

    config ESP_STATIC_IP_ADDR
        string "Static IP address"
        default "192.168.4.2"
        help
            Set static IP address.

    config ESP_STATIC_NETMASK_ADDR
        string "Static netmask address"
        default "255.255.255.0"
        help
            Set static netmask address.

    config ESP_STATIC_GW_ADDR
        string "Static gateway address"
        default "192.168.4.1"
        help
            Set static gateway address.

    choice ESP_STATIC_DNS_SERVER
        prompt "Choose DNS server"
        default ESP_STATIC_DNS_AUTO
        help
            Select auto to make gateway address as DNS server or manual to input your DNS server
        config ESP_STATIC_DNS_AUTO
            bool "Use gateway address as DNS server"
            help
                Set DNS server the same as gateway address

        config ESP_STATIC_DNS_MANUAL
            bool "Set manual value as DNS server"
            help
                Set DNS server with you want
    endchoice

    config ESP_STATIC_DNS_SERVER_MAIN
        string "Main DNS server address"
        default "192.168.4.1"
        depends on ESP_STATIC_DNS_MANUAL
        help
            Set main DNS server address.

    config ESP_STATIC_DNS_SERVER_BACKUP
        string "Backup DNS server address"
        default "192.168.4.1"
        depends on ESP_STATIC_DNS_MANUAL
        help
            Set backup DNS server address. It can be same with the main DNS server address or leave empty.

    config ESP_STATIC_DNS_RESOLVE_TEST
        bool "Enable DNS resolve test"
        default n
        help
            Enable it and configure ESP_STATIC_RESOLVE_DOMAIN to resolve DNS domain name

    config ESP_STATIC_RESOLVE_DOMAIN
        string "Domain name to resolve"
        default "www.espressif.com"
        depends on ESP_STATIC_DNS_RESOLVE_TEST
        help
            Set domain name for DNS test

    choice ESP_WIFI_SAE_MODE
        prompt "WPA3 SAE mode selection"
        default ESP_WPA3_SAE_PWE_BOTH
        help
            Select mode for SAE as Hunt and Peck, H2E or both.
        config ESP_WPA3_SAE_PWE_HUNT_AND_PECK
            bool "HUNT AND PECK"
        config ESP_WPA3_SAE_PWE_HASH_TO_ELEMENT
            bool "H2E"
        config ESP_WPA3_SAE_PWE_BOTH
            bool "BOTH"
    endchoice

    choice ESP_IP_MODE
        prompt "IP Version"
        depends on ESP_SOCKET_IP_INPUT_STRING
        help
            Example can use either IPV4 or IPV6.

        config ESP_IPV4
            bool "IPV4"

        config ESP_IPV6
            bool "IPV6"

    endchoice

    config ESP_IPV4_ADDR
        string "IPV4 Address"
        default "192.168.0.165"
        depends on ESP_IPV4
        help
            The example will connect to this IPV4 address.

    config ESP_IPV6_ADDR
        string "IPV6 Address"
        default "FE80::30AD:E57B:C212:68AD"
        depends on ESP_IPV6
        help
            The example will connect to this IPV6 address.

    config ESP_PORT
        int "Port"
        range 0 65535
        default 44440
        help
            The remote port to which the client example will connect to.

    choice ESP_INTERFACE
        prompt "Interface selection"
        depends on ESP_IPV6
        help
            Example can use either "Auto" or "User specified".

        config ESP_IFACE_AUTO
            bool "Auto"

        config ESP_USER_SPECIFIED_IFACE
            bool "User specified interface"
    endchoice

    config ESP_USER_SPECIFIED_IFACE_NAME
        string "User specified interface name"
        default "st1"
        depends on ESP_USER_SPECIFIED_IFACE
        help
            This interface will be used for communication.

    choice ESP_SOCKET_IP_INPUT
        prompt "Socket example source"
        default ESP_SOCKET_IP_INPUT_STRING
        help
            Selects the input source of the IP used in the example.

        config ESP_SOCKET_IP_INPUT_STRING
            bool "From string"

        config ESP_SOCKET_IP_INPUT_STDIN
            bool "From stdin"
    endchoice

endmenu
```

## EVK-NORA-W1/Light_sleep_vs_Power_Save/light_sleep_mode/sdkconfig.defaults
```kconfig
CONFIG_ESP_DEFAULT_CPU_FREQ_MHZ_80=y
CONFIG_ESP_DEFAULT_CPU_FREQ_MHZ=80
CONFIG_ULP_COPROC_ENABLED=y
CONFIG_ULP_COPROC_RESERVE_MEM=512
CONFIG_NEWLIB_TIME_SYSCALL_USE_RTC_HRT=y
CONFIG_RTC_CLK_SRC_INT_RC=y
CONFIG_BOOTLOADER_SKIP_VALIDATE_IN_DEEP_SLEEP=y
CONFIG_IDF_TARGET="esp32s3"
CONFIG_XTAL_FREQ_26=y

# Wi-Fi configuration

CONFIG_ESP_WIFI_SSID="Belchior"
CONFIG_ESP_WIFI_PASSWORD="sempreputo2017"
CONFIG_ESP_MAXIMUM_RETRY=5
CONFIG_ESP_STATIC_IP_ADDR="192.168.0.45"
CONFIG_ESP_STATIC_NETMASK_ADDR="255.255.255.0"
CONFIG_ESP_STATIC_GW_ADDR="192.168.0.1"
CONFIG_ESP_STATIC_DNS_AUTO=y
ONFIG_ESP_STATIC_DNS_RESOLVE_TEST=y
CONFIG_ESP_STATIC_RESOLVE_DOMAIN="www.espressif.com"
CONFIG_ESP_WPA3_SAE_PWE_BOTH=y

CONFIG_ESP_IPV4=y
CONFIG_ESP_IPV4_ADDR="192.168.0.32"
CONFIG_ESP_PORT=44440
CONFIG_ESP_SOCKET_IP_INPUT_STRING=y
```
